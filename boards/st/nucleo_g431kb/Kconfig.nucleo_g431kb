## boards/st/nucleo_g431kb/Kconfig.nucleo_g431kb
```kconfig
# Copyright (c) 2019 Richard Osterloh <richard.osterloh@gmail.com>
# SPDX-License-Identifier: Apache-2.0

config BOARD_NUCLEO_G431KB
	select SOC_STM32G431XX
```
